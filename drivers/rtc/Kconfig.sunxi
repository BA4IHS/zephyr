## drivers/rtc/Kconfig.sunxi
```kconfig
# Copyright (c) 2026 Yuzuki Tsuru
# SPDX-License-Identifier: Apache-2.0

config RTC_SUNXI
	bool "Allwinner sunxi RTC driver"
	default y
	depends on DT_HAS_ALLWINNER_SUNXI_RTC_ENABLED
	help
	  Enable the real time clock of the Allwinner sunxi SoCs: the date and the time of day
	  from 1970 to 2097, and one alarm that fires at a date and time.
```

## dts/bindings/rtc/allwinner,sunxi-rtc.yaml
```yaml
# Copyright (c) 2026 Yuzuki Tsuru
# SPDX-License-Identifier: Apache-2.0

description: Allwinner sunxi real time clock (day counter and time of day, one alarm)

compatible: "allwinner,sunxi-rtc"

include: [rtc-device.yaml, base.yaml]

properties:
  reg:
    required: true

  interrupts:
    required: true

  clock-source:
    type: string
    default: "keep"
    enum:
      - "keep"
      - "internal"
      - "external"
      - "hosc"
    description: |
      The 32 kHz clock that counts the seconds. "keep" leaves what the boot code configured.
      "internal" is the on-chip RC oscillator (its rate is off by a lot: 60 % was measured),
      "external" the 32.768 kHz crystal, "hosc" the 24 MHz main crystal divided by 750, which is
      as accurate as the main crystal but runs only while the chip is powered.
```

## lib/opencore_aac/Kconfig
```kconfig
# Copyright (c) 2026 Yuzuki Tsuru
# SPDX-License-Identifier: Apache-2.0

config OPENCORE_AAC
	bool "OpenCORE AAC decoder"
	help
	  Fixed-point AAC-LC decoder of the OpenCORE multimedia framework
	  (west project modules/lib/opencore, Apache-2.0). Integer only, no
	  libm. AAC_PLUS is not defined in this build, so the SBR and PS tools
	  of HE-AAC are not decoded. The decoder sources are C written in .cpp
	  files and are built as C.
```

## samples/drivers/sdhc_sunxi/sample.yaml
```yaml
sample:
  name: Allwinner SMHC SD card test
tests:
  sample.drivers.sdhc_sunxi:
    platform_allow:
      - yuzukineko
    tags: sdhc
    harness: console
    harness_config:
      type: one_line
      regex:
        - "SD test done"
```

## samples/drivers/usb/cherryusb_cdc_acm/sample.yaml
```yaml
sample:
  name: CherryUSB CDC ACM on the sunxi OTG controller
tests:
  sample.drivers.usb.cherryusb_cdc_acm:
    platform_allow: yuzukineko
    tags: usb
    harness: none
    build_only: true
```

## samples/drivers/usb/cherryusb_host/sample.yaml
```yaml
sample:
  name: CherryUSB host (EHCI/OHCI) on the sunxi USB port
tests:
  sample.drivers.usb.cherryusb_host:
    platform_allow: yuzukineko
    tags: usb
    harness: none
    build_only: true
```
