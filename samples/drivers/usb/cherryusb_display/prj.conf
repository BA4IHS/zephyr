## Kconfig
```
# Copyright (c) 2026 Yuzuki Tsuru
# SPDX-License-Identifier: Apache-2.0

mainmenu "USB second screen"

config SAMPLE_USB_DISPLAY_WIDTH
	int "Width the host is told, 0 for the width of the panel"
	default 0

config SAMPLE_USB_DISPLAY_HEIGHT
	int "Height the host is told, 0 for the height of the panel"
	default 0

config SAMPLE_USB_DISPLAY_FPS
	int "Frame rate the host is told"
	default 60
	range 1 120

config SAMPLE_USB_DISPLAY_QUALITY
	int "JPEG quality the host is told (1..10)"
	default 9
	range 1 10

config SAMPLE_USB_DISPLAY_TOUCH
	bool "Add a HID multi-touch screen to the device"
	default y
	help
	  Makes the device a composite one: the display on interface 0 and a five finger
	  touch screen on interface 1. Windows loads its own driver for the latter.

config SAMPLE_USB_DISPLAY_TOUCH_DEMO
	bool "Send a synthetic two finger drag when the host has configured the device"
	depends on SAMPLE_USB_DISPLAY_TOUCH

config SAMPLE_USB_DISPLAY_CTP
	bool "Take the touch points from the touch panel of the board (input subsystem, node label touch)"
	depends on SAMPLE_USB_DISPLAY_TOUCH && $(dt_nodelabel_enabled,touch)
	default y

config SAMPLE_USB_DISPLAY_CTP_SWAP
	bool "Exchange X and Y of the touch panel"
	depends on SAMPLE_USB_DISPLAY_CTP

config SAMPLE_USB_DISPLAY_CTP_FLIP_X
	bool "Mirror X of the touch panel"
	depends on SAMPLE_USB_DISPLAY_CTP
	default y
	help
	  With the flip of Y this is the 180 degree turn of the panel of the board against the
	  picture the PC sees.

config SAMPLE_USB_DISPLAY_CTP_FLIP_Y
	bool "Mirror Y of the touch panel"
	depends on SAMPLE_USB_DISPLAY_CTP
	default y

source "Kconfig.zephyr"
```

## sample.yaml
```
sample:
  name: USB second screen
tests:
  sample.drivers.usb.cherryusb_display:
    platform_allow: yuzukineko
    tags: usb display
    harness: none
    build_only: true
```

## prj.conf
```kconfig
CONFIG_CHERRYUSB=y
CONFIG_CHERRYUSB_DEVICE=y
CONFIG_CHERRYUSB_DEVICE_SPEED_HS=y
CONFIG_CHERRYUSB_DEVICE_MUSB_SUNXI=y
CONFIG_CHERRYUSB_DEVICE_DISPLAY=y
CONFIG_CHERRYUSB_DEVICE_HID=y

CONFIG_DISPLAY=y
CONFIG_VDEC=y
CONFIG_FPU=y
CONFIG_FPU_SHARING=y

CONFIG_MAIN_STACK_SIZE=8192
CONFIG_SYSTEM_WORKQUEUE_STACK_SIZE=2048
CONFIG_COMMON_LIBC_MALLOC_ARENA_SIZE=-1
CONFIG_HEAP_MEM_POOL_SIZE=65536
CONFIG_PRINTK=y
CONFIG_SHELL=n
CONFIG_DEVMEM_SHELL=n

# drivers the second screen does not use
CONFIG_G2D=n
CONFIG_ADC=n
CONFIG_SPI=n
CONFIG_I2C=y
CONFIG_GPIO=y
CONFIG_INPUT=y
CONFIG_INPUT_GT967_MAX_TOUCH_POINTS=5
CONFIG_MIPI_DBI=n
CONFIG_WDT_SUNXI=n

# a small image: no logging (errors of the drivers are not printed), size optimised code
CONFIG_LOG=n
CONFIG_SIZE_OPTIMIZATIONS=y

# the frame buffer comes from the heap, not from the image
CONFIG_DISPLAY_SUNXI_FB_ALLOC=y
```

## src/usb_ctp.c
```c
/*
 * Copyright (c) 2026 Yuzuki Tsuru
 *
 * SPDX-License-Identifier: Apache-2.0
 */

/*
 * The capacitive touch panel (the touch node of the board, a GT967 on I2C1 with its driver in the
 * input subsystem) as the touch screen of the USB display: the input events of the panel are
 * collected per finger and turned into reports of the HID touch interface.
 */

#include <errno.h>
#include <string.h>

#include <zephyr/kernel.h>
#include <zephyr/device.h>
#include <zephyr/input/input.h>

#include "usb_ctp.h"
#include "usb_touch.h"

#define TOUCH_NODE	DT_NODELABEL(touch)
#define CTP_MAX_X	DT_PROP(TOUCH_NODE, screen_width)
#define CTP_MAX_Y	DT_PROP(TOUCH_NODE, screen_height)
#define POINTS		USB_TOUCH_MAX_CONTACTS
#define SEND_WAIT_MS	20

static const struct device *const touch_dev = DEVICE_DT_GET(TOUCH_NODE);

static bool swap_xy = IS_ENABLED(CONFIG_SAMPLE_USB_DISPLAY_CTP_SWAP);
static bool flip_x = IS_ENABLED(CONFIG_SAMPLE_USB_DISPLAY_CTP_FLIP_X);
static bool flip_y = IS_ENABLED(CONFIG_SAMPLE_USB_DISPLAY_CTP_FLIP_Y);

/*
 * A finger the panel loses for a moment would end a drag selection or a press and hold on the PC,
 * so a lift is reported only when the finger stays away for UP_DEBOUNCE_MS. While a finger is
 * down the report is repeated every BEAT_MS, as the PC expects from a touch screen.
 */
#define UP_DEBOUNCE_MS	50
#define BEAT_MS		20

/* what the input events tell about each finger (slot) */
static struct {
	uint16_t x, y;		/* in panel pixels */
	bool down;		/* as the PC knows it */
	bool lifted;		/* one more report with the tip switch off */
	uint32_t up_at;		/* the panel lost the finger: when to tell the PC, 0 when it is down */
} slot[POINTS];
static int cur_slot;
static struct k_spinlock lock;
static struct k_work_q ctp_q;
K_THREAD_STACK_DEFINE(ctp_q_stack, 2048);
static void ctp_beat(struct k_work *work);
static K_WORK_DELAYABLE_DEFINE(ctp_work, ctp_beat);

static void scale(uint32_t x, uint32_t y, uint16_t *ox, uint16_t *oy)
{
	uint32_t max_x = CTP_MAX_X, max_y = CTP_MAX_Y;

	if (swap_xy) {
		uint32_t t = x;

		x = y;
		y = t;
		max_x = CTP_MAX_Y;
		max_y = CTP_MAX_X;
	}
	if (flip_x) {
		x = max_x - 1 - MIN(x, max_x - 1);
	}
	if (flip_y) {
		y = max_y - 1 - MIN(y, max_y - 1);
	}
	x = MIN(x, max_x - 1);
	y = MIN(y, max_y - 1);
	*ox = x * USB_TOUCH_MAX / (max_x - 1);
	*oy = y * USB_TOUCH_MAX / (max_y - 1);
}

/*
 * One report with the slots 0..count-1, a lifted finger once with its tip switch off. It runs in
 * a queue of its own: the input events come in the system work queue, which must not wait for the
 * USB endpoint.
 */
static void ctp_beat(struct k_work *work)
{
	struct usb_touch_point out[POINTS];
	uint32_t now = k_uptime_get_32();
	bool any = false;
	int count = 0;
	k_spinlock_key_t key;

	ARG_UNUSED(work);
	memset(out, 0, sizeof(out));
	key = k_spin_lock(&lock);
	for (int i = 0; i < POINTS; i++) {
		if (slot[i].down && slot[i].up_at != 0 && (int32_t)(now - slot[i].up_at) >= 0) {
			slot[i].down = false;
			slot[i].lifted = true;
			slot[i].up_at = 0;
		}
		out[i].id = i;
		if (slot[i].down || slot[i].lifted) {
			out[i].down = slot[i].down;
			scale(slot[i].x, slot[i].y, &out[i].x, &out[i].y);
			count = i + 1;
		}
		slot[i].lifted = false;
		any |= slot[i].down;
	}
	k_spin_unlock(&lock, key);

	if (count != 0) {
		for (int n = 0; usb_touch_send(out, count) == -EBUSY && n < SEND_WAIT_MS; n++) {
			k_msleep(1);
		}
	}
	if (any) {
		k_work_schedule_for_queue(&ctp_q, &ctp_work, K_MSEC(BEAT_MS));
	}
}

static void ctp_event(struct input_event *evt, void *user_data)
{
	k_spinlock_key_t key = k_spin_lock(&lock);

	switch (evt->code) {
	case INPUT_ABS_MT_SLOT:
		cur_slot = CLAMP(evt->value, 0, POINTS - 1);
		break;
	case INPUT_ABS_X:
		slot[cur_slot].x = evt->value;
		break;
	case INPUT_ABS_Y:
		slot[cur_slot].y = evt->value;
		break;
	case INPUT_BTN_TOUCH:
		if (evt->value) {
			slot[cur_slot].down = true;
			slot[cur_slot].up_at = 0;
		} else if (slot[cur_slot].down && slot[cur_slot].up_at == 0) {
			slot[cur_slot].up_at = k_uptime_get_32() + UP_DEBOUNCE_MS;
		}
		break;
	default:
		break;
	}
	k_spin_unlock(&lock, key);
	if (evt->sync) {
		k_work_reschedule_for_queue(&ctp_q, &ctp_work, K_NO_WAIT);
	}
}
INPUT_CALLBACK_DEFINE(DEVICE_DT_GET(TOUCH_NODE), ctp_event, NULL);

void usb_ctp_start(void)
{
	if (!device_is_ready(touch_dev)) {
		printk("usb ctp: the touch panel is not ready\n");
		return;
	}
	k_work_queue_init(&ctp_q);
	k_work_queue_start(&ctp_q, ctp_q_stack, K_THREAD_STACK_SIZEOF(ctp_q_stack), 6, NULL);
	printk("usb ctp: touch panel %s, %ux%u\n", touch_dev->name, CTP_MAX_X, CTP_MAX_Y);
}
```

## src/usb_ctp.h
```c
/*
 * Copyright (c) 2026 Yuzuki Tsuru
 *
 * SPDX-License-Identifier: Apache-2.0
 */

#ifndef USB_CTP_H_
#define USB_CTP_H_

/* check the touch panel; its input events are sent to the USB touch screen from then on */
void usb_ctp_start(void);

#endif
```
